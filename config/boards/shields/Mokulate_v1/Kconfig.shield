## config/boards/shields/Mokulate_v1/Kconfig.shield
```kconfig
config MOKULATE_V1_LEFT
    def_bool $(shields_list_contains,Mokulate_v1_left)

config MOKULATE_V1_RIGHT
    def_bool $(shields_list_contains,Mokulate_v1_right)
```

## config/boards/shields/Mokulate_v2/Kconfig.defconfig
```kconfig
if MOKULATE_V2_RIGHT

config ZMK_KEYBOARD_NAME
    default "Mokulate"

config ZMK_SPLIT_ROLE_CENTRAL
    default y

endif

if MOKULATE_V2_LEFT || MOKULATE_V2_RIGHT

config ZMK_SPLIT
    default y

endif
```

## config/boards/shields/Mokulate_v2/Kconfig.shield
```kconfig
config MOKULATE_V2_LEFT
    def_bool $(shields_list_contains,Mokulate_v2_left)

config MOKULATE_V2_RIGHT
    def_bool $(shields_list_contains,Mokulate_v2_right)
```

## config/west.yml
```yaml
manifest:
  defaults:
    revision: main
  remotes:
    - name: cormoran
      url-base: https://github.com/cormoran
    - name: sekigon-gonnoc
      url-base: https://github.com/sekigon-gonnoc
  projects:
    - name: zmk
      remote: cormoran
      revision: main+dya
      import:
        file: app/west.yml
    - name: zephyr
      remote: cormoran
      revision: v4.1.0+zmk-fixes+nrf-half-duplex-uart
      clone-depth: 1
      import:
        name-blocklist:
          - ci-tools
          - hal_altera
          - hal_cypress
          - hal_infineon
          - hal_microchip
          - hal_nxp
          - hal_openisa
          - hal_xtensa
          - hal_st
          - hal_ti
          - loramac-node
          - mcuboot
          - mcumgr
          - net-tools
          - openthread
          - edtt
          - trusted-firmware-m
    - name: zmk-feature-custom-settings
      remote: cormoran
      revision: main
    - name: zmk-feature-fast-keymap
      remote: cormoran
      revision: main
    - name: zmk-module-ble-management
      remote: cormoran
    - name: zmk-module-battery-history
      remote: cormoran
    - name: zmk-module-settings-rpc
      remote: cormoran
    - name: zmk-module-runtime-input-processor
      remote: cormoran
      revision: main
    - name: zmk-feature-runtime-combo
      remote: cormoran
      revision: main
    - name: zmk-feature-runtime-macro
      remote: cormoran
      revision: main
    - name: zmk-feature-kscan-diagnostics
      remote: cormoran
      revision: main
    - name: zmk-feature-input-stream
      remote: cormoran
      revision: main
    - name: zmk-module-devtool
      remote: cormoran
      revision: main
    - name: zmk-feature-device-info
      remote: cormoran
      revision: main
    - name: zmk-feature-watchdog
      remote: cormoran
      revision: main
    - name: zmk-feature-zephyr-setting-expose
      remote: cormoran
      revision: main
    - name: zmk-feature-studio-rpc-perf
      remote: cormoran
      revision: main
    - name: zmk-feature-non-lipo-battery-management
      remote: sekigon-gonnoc
    - name: zmk-driver-paw3222
      remote: sekigon-gonnoc
  self:
    path: config
```
