## config/boards/shields/Mokulate/Kconfig.defconfig
```kconfig
if MOKULATE_RIGHT

config ZMK_KEYBOARD_NAME
    default "Mokulate"

config ZMK_SPLIT_ROLE_CENTRAL
    default y

endif

if MOKULATE_LEFT || MOKULATE_RIGHT

config ZMK_SPLIT
    default y

endif
```

## config/boards/shields/Mokulate/Kconfig.shield
```kconfig
config MOKULATE_LEFT
    def_bool $(shields_list_contains,Mokulate_left)

config MOKULATE_RIGHT
    def_bool $(shields_list_contains,Mokulate_right)
```
